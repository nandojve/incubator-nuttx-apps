## examples/coap/Kconfig
```kconfig
#
# For a description of the syntax of this configuration file,
# see the file kconfig-language.txt in the NuttX tools repository.
#

config EXAMPLES_COAP
	tristate "CoAP Server/Client"
	default n
	select NETUTILS_LIBCOAP
	---help---
		Enable the CoAP Server/Client example

if EXAMPLES_COAP

config EXAMPLES_COAP_PRIORITY
	int "Coap Server/Client task priority"
	default 100

config EXAMPLES_COAP_STACKSIZE
	int "CoAP Server/Client stack size"
	default 8192

endif
```

## netutils/libcoap/Kconfig
```kconfig
#
# For a description of the syntax of this configuration file,
# see the file kconfig-language.txt in the NuttX tools repository.
#

config NETUTILS_LIBCOAP
	bool "libCoAP (current version)"
	default n
	select NET
	select NET_UDP
	---help---
		Enable support for the libcoap library 

if NETUTILS_LIBCOAP

config NETUTILS_LIBCOAP_URL
	string "URL where libCoAP library can be downloaded"
	default "https://github.com/obgm/libcoap/archive"

config NETUTILS_LIBCOAP_VERSION
	string "Version number"
	default "4.3.0"

config NETUTILS_LIBCOAP_DEBUG
	bool "Enable CoAP Debugging Log"
	default y
	---help---
		Enables CoAP logs

endif
```
